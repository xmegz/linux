## drivers/gpu/arm/ump/Kconfig
```kconfig
config UMP
	tristate "UMP support"
	---help---
	  This enables support for the UMP memory allocation and sharing API.

	  To compile this driver as a module, choose M here: the module will be
	  called ump.

config UMP_DEBUG
	bool "Enable extra debug in UMP"
	depends on UMP
	default n
	---help---
	  This enabled extra debug checks and messages in UMP.

config UMP_USING_OS_MEMORY
	bool "Using OS memory"
	depends on UMP
	default y
	---help---
		This makes UMP use OS memory.

config UMP_MEM_SIZE
	int "UMP Memory Size"
	depends on UMP
	default "64"
	---help---
		This value decide memory size of UMP (unit is MByte).
```
